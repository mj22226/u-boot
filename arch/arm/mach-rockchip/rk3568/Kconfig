## arch/arm/mach-rockchip/rk3568/Kconfig
```kconfig
if ROCKCHIP_RK3568

config TARGET_BPI_R2_PRO_RK3568
	bool "Banana Pi R2 Pro RK3566 development board"
	help
	  Banana Pi R2 Pro is a development board Rockchp RK3568.

config TARGET_EVB_RK3568
	bool "RK3568 evaluation board"
	select BOARD_LATE_INIT
	help
	  RK3568 EVB is a evaluation board for Rockchp RK3568.

config TARGET_NANOPI_R5S_RK3568
	bool "NanoPi R5S board"
	help
	  NanoPi R5S FriendlyElec is a board for Rockchp RK3568.

config ROCKCHIP_BOOT_MODE_REG
	default 0xfdc20200

config ROCKCHIP_STIMER_BASE
	default 0xfdd1c020

config SYS_SOC
	default "rk3568"

config SYS_MALLOC_F_LEN
	default 0x2000

source "board/rockchip/bpi-r2-pro-rk3568/Kconfig"
source "board/rockchip/evb_rk3568/Kconfig"
source "board/friendlyelec/nanopi-r5s-rk3568/Kconfig"

endif
```

## board/friendlyelec/nanopi-r5s-rk3568/Kconfig
```kconfig
if TARGET_NANOPI_R5S_RK3568

config SYS_BOARD
	default "nanopi-r5s-rk3568"

config SYS_VENDOR
	default "friendlyelec"

config SYS_CONFIG_NAME
	default "nanopi-r5s-rk3568"

config BOARD_SPECIFIC_OPTIONS # dummy
	def_bool y

endif
```

## board/friendlyelec/nanopi-r6c-rk3588/Kconfig
```kconfig
if TARGET_NANOPI_R6C_RK3588

config SYS_BOARD
	default "nanopi-r6c-rk3588"

config SYS_VENDOR
	default "friendlyelec"

config SYS_CONFIG_NAME
	default "nanopi-r6c-rk3588"

config BOARD_SPECIFIC_OPTIONS # dummy
	def_bool y

endif
```

## board/rockchip/bpi-r2-pro-rk3568/Kconfig
```kconfig
if TARGET_BPI_R2_PRO_RK3568

config SYS_BOARD
	default "bpi-r2-pro-rk3568"

config SYS_VENDOR
	default "rockchip"

config SYS_CONFIG_NAME
	default "bpi-r2-pro-rk3568"

config BOARD_SPECIFIC_OPTIONS # dummy
	def_bool y

endif
```
